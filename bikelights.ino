#include "FastLED.h"
#include "SPI.h"
#include "SD.h"
#include "math.h"
#define NUM_LEDS 96              // Total # of LEDs

struct CRGB leds[NUM_LEDS];      // LEDs struct

const int hallPin = 2;           // Hall sensor on pin 2
const int chipSelect = 10;

volatile long lastMeasurement;   // Time of last measurement
volatile long curSpeed;          // Current rotational speed

int intangle;                    // Integer angle value % 360
int angle;                       // Integer angle value raw
int offset = 90;                 // Used to adjust for angle of fork with magnet
int tempangle;                   // Calculated angle of each strip
int x;                           // 
long curTime;                    // Current time since power on
byte serialA;                    // Last byte read from BT 

float ratio = 360/180.0;         // Ratio of degrees to width of images in pixels

// 2 dimensional array of R values
byte _r[24][180] = {{0, 0, 0, 0, 0, 0, 0, 0, 0, 0, 0, 0, 0,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 215, 215},
{0, 141, 141, 141, 141, 141, 141, 141, 141, 141, 141, 141, 0,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 255, 255},
{141, 141, 0, 0, 0, 0, 0, 0, 0, 0, 0, 0, 0,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 141, 141},
{0, 0, 0, 0, 0, 0, 0, 0, 0, 0, 0, 0, 0,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 141, 141},
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{255, 252, 0, 0, 0, 0, 0, 0, 0, 0, 0, 0, 0,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 252, 252}};

// 2 dimensional array of G values
byte _g[24][180] = {{148, 148, 148, 148, 148, 148, 148, 148, 148, 148, 148, 148, 104,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 223, 223},
{148, 198, 198, 198, 198, 198, 198, 198, 198, 198, 198, 198, 104,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 143, 143},
{198, 198, 104, 104, 104, 104, 104, 104, 104, 104, 104, 104, 104,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 198, 198},
{104, 104, 0, 0, 0, 0, 0, 0, 0, 0, 0, 0, 0,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 198, 198},
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{255, 252, 0, 0, 0, 0, 0, 0, 0, 0, 0, 0, 0,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 252, 252}};

// 2 dimensional array of B values
byte _b[24][180] = {{68, 68, 68, 68, 68, 68, 68, 68, 68, 68, 68, 68, 56,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 35, 35},
{68, 63, 63, 63, 63, 63, 63, 63, 63, 63, 63, 63, 56,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 0, 0},
{63, 63, 56, 56, 56, 56, 56, 56, 56, 56, 56, 56, 56,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 63, 63},
{56, 56, 0, 0, 0, 0, 0, 0, 0, 0, 0, 0, 0,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 63, 63},
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{255, 252, 0, 0, 0, 0, 0, 0, 0, 0, 0, 0, 0,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 252, 252}};

void setup()
{
  // Serial connection for Serial Monitor and BT module
  //Serial.begin(57600);
  Serial1.begin(57600);

  // Set hall sensor pin to input, set pull-up resistor and set interrupt
  pinMode(hallPin, INPUT);
  digitalWrite(hallPin, HIGH);
  attachInterrupt(hallPin, update, FALLING);
  
  // Store current time as lastMeasurement of hall sensor interrupt
  lastMeasurement = micros();

  // Try to initialize the SD card
  if (SD.begin(chipSelect)) {
    // If SD card is present load first image it
    loadPic(0);
  } 

  // Set LED brightness (0-255) and LEDs - 8806s bit banging on pins 5 and 7
  LEDS.setBrightness(30);
  LEDS.addLeds<LPD8806, 5, 7, BGR>(leds, NUM_LEDS);
}

void loop()
{ 
  // If the bluetooth module has a byte to read 
  if (Serial1.available() > 0) 
  {
    // Set serialA to the byte read from the bluetooth module, print to serial monitor
    serialA = Serial1.read();
    //Serial.println(serialA);
  }
  
  // Switch on the value received by the bluetooth module
  switch (serialA) 
  {
    
    // Android app sends 'r' when it first connects, indicates a request
    // for a list of files on the SD card to be sent via BT
    case 'r':
      listFiles();
      break;
      
    // All other cases
    default:
      // If byte is a decimal number treat it as a request to change displayed image
      if (serialA >= static_cast<int>('0') && serialA <= static_cast<int>('9'))
      {
        // Variable to hold the requested pic number, - '0' converts from char to int
        int picNum = serialA - '0';
        
          // If another byte is ready to read (eg. image '10' was requested)
          if (Serial1.available() > 0) 
          {
            // Read the byte - if it's another number append it to picNum
            serialA = Serial1.read();
            if (serialA >= static_cast<int>('0') && serialA <= static_cast<int>('9'))
            {
              picNum = picNum*10 + (serialA - '0'); 
              
              // Check one last time - this gives a potential of 3 digits or 1000 images (0-999)
              if (Serial1.available() > 0) 
              {
                serialA = Serial1.read();
                if (serialA >= static_cast<int>('0') && serialA <= static_cast<int>('9'))
                {
                  picNum = picNum*100 + (serialA - '0'); 
                }
              }
            }
          }
        // Set all of the LEDs green to indicate loading 
        // is happening then load the requested pic
        loadingLEDs();
        LEDS.show();
        loadPic(picNum);
      }
      break;
  }
  
  // Set the current time and find the time since the last interrupt
  curTime = micros();
  curTime = curTime - lastMeasurement;
  // Calculate the current angle of the wheel based on the speed of the
  // last revolution and the amount of time since the last interrupt
  angle = (((double)curTime / (double)curSpeed ) * 360) + offset;
  // Get the angle in an integer format
  intangle = (int)angle%360;
  
  // First strip 0 - 12
  // Calculate the current angle of the first strip
  if (intangle < 315)
  {
    tempangle = 315 - intangle;
  } else {
    tempangle = 675 - intangle;
  }
  // Clear the values of the first strip
  clearLEDrange(0, 12);
  // Hacky temp variable to enable immitating 24 pixels with 2 12 pixel strips
  int temp = 22;
  // Translate current angle to the size of the current image
  x = (int) tempangle/ratio;
  // Itterate over the first strip of LEDs
  for (int pix = 0; pix < 12; pix++)
  {
    // Load the appropriate RGB values from memory
    leds[pix] = CRGB(_g[temp][x],_r[temp][x],_b[temp][x]);  
    // Skip LEDs to immitate a 24 LED strip with only 12
    temp = temp - 2;
  }
  
  ////////////////////
  // Second strip 12 - 24
  // Calculate the current angle of the first strip
  if(intangle < 135)
  { 
    tempangle = 360 - (135 - intangle);
  } else {
    tempangle = 360 - (495 - intangle);
  }
  // Clear the values of the first strip
  clearLEDrange(12, 24);
  // Hacky temp variable to enable immitating 24 pixels with 2 12 pixel strips
  temp = 22;
  // Translate current angle to the size of the current image
  x = (int) tempangle/ratio;
  // Itterate over the first strip of LEDs
  for (int pix = 23; pix > 11 ; pix--)
  {
    // Load the appropriate RGB values from memory
    leds[pix] = CRGB(_g[temp][x],_r[temp][x],_b[temp][x]);  
    // Skip LEDs to immitate a 24 LED strip with only 12
    temp = temp - 2;
  }
    
  // Third strip 24 - 36
  if(intangle < 225)
  { 
    tempangle = 360 - (225 - intangle);
  } else {
    tempangle = 360 - (585 - intangle);
  }
  clearLEDrange(24, 36);
  temp = 23;
  x = (int) tempangle/ratio;
  for (int pix = 24; pix < 36; pix++)
  {
    leds[pix] = CRGB(_g[temp][x],_r[temp][x],_b[temp][x]); 
    temp = temp - 2;
  }
  //////////////////////
    
  // Fourth strip 36 - 48
  if (intangle < 45)
  {
    tempangle = 45 - intangle;
  } else {
    tempangle = 405 - intangle;
  }
  clearLEDrange(36, 48);
  temp = 23;
  x = (int) tempangle/ratio;
  for (int pix = 47; pix > 35 ; pix--)
  {
    leds[pix] = CRGB(_g[temp][x],_r[temp][x],_b[temp][x]); 
    temp = temp - 2;
  }

  // Fifth strip 48 - 60
  if(intangle < 135)
  { 
    tempangle = 135 - intangle;
  } else {
    tempangle = 495 - intangle;
  }
  clearLEDrange(48, 60);
  temp = 22;
  x = (int) tempangle/ratio;
  for (int pix = 48; pix < 60; pix++)
  {
    leds[pix] = CRGB(_g[temp][x],_r[temp][x],_b[temp][x]);   
    temp = temp - 2;
  }
  
  ////////////////////
  // Sixth strip 60 - 72
  // Calculate the current angle of the first strip
  if (intangle < 315)
  {
    tempangle = 360 - (315 - intangle);
  } else {
    tempangle = 360 - (675 - intangle);
  }
  // Clear the values of the first strip
  clearLEDrange(60, 72);
  // Hacky temp variable to enable immitating 24 pixels with 2 12 pixel strips
  temp = 22;
  // Translate current angle to the size of the current image
  x = (int) tempangle/ratio;
  // Itterate over the first strip of LEDs
  for (int pix = 71; pix > 59 ; pix--)
  {
    // Load the appropriate RGB values from memory
    leds[pix] = CRGB(_g[temp][x],_r[temp][x],_b[temp][x]);  
    // Skip LEDs to immitate a 24 LED strip with only 12
    temp = temp - 2;
  }
    
  // Seventh strip 72 - 84
  if (intangle < 45)
  {
    tempangle = 360 - (45 - intangle);
  } else {
    tempangle = 360 - (405 - intangle);
  }
  clearLEDrange(72, 84);
  temp = 23;
  x = (int) tempangle/ratio;
  for (int pix = 72; pix < 84; pix++)
  {
    leds[pix] = CRGB(_g[temp][x],_r[temp][x],_b[temp][x]); 
    temp = temp - 2;
  }
  //////////////////////
    
  // Eighth strip 84 - 96
  if(intangle < 225)
  { 
    tempangle = 225 - intangle;
  } else {
    tempangle = 585 - intangle;
  }
  clearLEDrange(84, 96);
  temp = 23;
  x = (int) tempangle/ratio;
  for (int pix = 95; pix > 83; pix--)
  {
    leds[pix] = CRGB(_g[temp][x],_r[temp][x],_b[temp][x]);   
    temp = temp - 2;
  }
  
  // Show LEDs
  LEDS.show();
}

// When hall effect sensor triggers
void update()              
{
  //Serial.println("Interrput");
  // Set the current speed and last interrupt variables
  curTime = micros();
  curSpeed = curTime - lastMeasurement;
  lastMeasurement = curTime;
}

// Clear all LEDs
void clearLEDs()
{
  for (int pix = 0; pix < NUM_LEDS; pix++)
  {
    leds[pix] = CRGB(0,0,0);   
  }  
}

// Clear range of LEDs
void clearLEDrange(int first, int last)
{
  for (int pix = first; pix < last; pix++)
  {
    leds[pix] = CRGB(0,0,0);   
  }  
}

// Clear all LEDs
void loadingLEDs()
{
  for (int pix = 0; pix < NUM_LEDS; pix++)
  {
    leds[pix] = CRGB(255,0,0);   
  }  
}

// Load requested pic from SD card to memory
void loadPic(int pic)
{
  //Serial.println(pic);
  File myFile;
  long line_count = 0;
  int comma_count = 0;
  int r, g, b;
  String r_s, g_s, b_s;
  int i = 0;
  
  // Open root of SD card and seek to the beginning
  File root, entry;
  root = SD.open("/");
  root.seek(0);
  root.openNextFile();
  
  // Iterate over files until correct numbered file is found
  while ( i < pic + 1 )
  {
    entry = root.openNextFile();
    if (! entry) break;
    i++;
  }
  
  // Send file name to serial monitor and open the file
  //Serial.println(entry.name());
  myFile = SD.open(entry.name());
  
  // Close out unnecessary connections
  entry.close();
  root.close();
 
  // While we haven't reached EOF
  // Each line should be formatted: {0,0,0}
  while (myFile.available()) 
  {
    // Read the next char
    char temp_char = myFile.read();
    
    // Ignore opening braces
    if (temp_char == '{') continue;
    
    // If it's an end brace it signifies the end of one pixel worth
    // of data, do stuff with it
    if (temp_char == '}')
    {
      // Create char arrays of proper length to aid in string -> int
      char char_r[r_s.length() + 1];
      char char_g[g_s.length() + 1];
      char char_b[b_s.length() + 1];
      
      // Convert strings into the new char arrays
      r_s.toCharArray(char_r, sizeof(char_r));
      g_s.toCharArray(char_g, sizeof(char_g));
      b_s.toCharArray(char_b, sizeof(char_b));
      
      // Convert char arrays to integers
      r = atoi(char_r);
      g = atoi(char_g);
      b = atoi(char_b);
      
      // Use integers and linecount to properly store RGB values
      _r[line_count / 180][line_count % 180] = r;
      _g[line_count / 180][line_count % 180] = g;
      _b[line_count / 180][line_count % 180] = b;
      
      // Increment line count, reset other variables
      line_count++;
      comma_count = 0;
      r_s = "";
      g_s = "";
      b_s = "";
      continue;
    }
    
    // If comma increment comma count and continue
    if (temp_char == ',') 
    {
      comma_count++;
      continue;
    }
    
    // If comma count is 0 we know we're reading the R value and store it
    if (comma_count == 0)
    {
      r_s = r_s + temp_char;
    }
    
    // If comma count is 1 we know we're reading the G value and store it
    else if (comma_count == 1)
    {
      g_s = g_s + temp_char;
    }
    
    // If comma count is 2 we know we're reading the B value and store it
    else if (comma_count == 2)
    {
      b_s = b_s + temp_char;
    }
  }
  // Close out the image file
  myFile.close();
}

// Transmit list of files on SD card via BT
void listFiles()
{
  // Open up the root directory and seek to the beginning
  File root = SD.open("/");
  root.seek(0);
  root.openNextFile();
  
  // While there are still files in the root dir send their name
  // to both serial monitor and transmit via bluetooth, then close
  while(true) {
    File entry =  root.openNextFile();
    if (! entry) {
      // no more files
      return;
    }
    //Serial.println(entry.name());
    Serial1.println(entry.name());
    entry.close();
  }
}

